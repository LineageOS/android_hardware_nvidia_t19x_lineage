// SPDX-License-Identifier: GPL-2.0

&{/} {
	#address-cells = <2>;
	#size-cells = <2>;

	reserved-memory {
		#address-cells = <2>;
		#size-cells = <2>;
		ranges;

		ramoops_carveout {
			compatible = "ramoops";
			size = <0x0 0x200000>;
			record-size = <0x00010000>;
			console-size = <0x00080000>;
			alignment = <0x0 0x10000>;
			alloc-ranges = <0x0 0x0 0x1 0x0>;
			no-map;
		};
	};
};
